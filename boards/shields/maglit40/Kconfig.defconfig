## boards/shields/maglit40/Kconfig.defconfig
```kconfig
if SHIELD_MAGLIT40_LEFT

config ZMK_KEYBOARD_NAME
    default "Maglit40"

config ZMK_SPLIT_ROLE_CENTRAL
    default y

endif

if SHIELD_MAGLIT40_LEFT || SHIELD_MAGLIT40_RIGHT

config ZMK_SPLIT
    default y

endif
```

## boards/shields/maglit40/Kconfig.shield
```kconfig
config SHIELD_MAGLIT40_LEFT
    def_bool $(shields_list_contains,maglit40_left)

config SHIELD_MAGLIT40_RIGHT
    def_bool $(shields_list_contains,maglit40_right)
```

## boards/shields/nox40/Kconfig.defconfig
```kconfig
if SHIELD_NOX40_LEFT

config ZMK_KEYBOARD_NAME
    default "NOX40"

config ZMK_SPLIT_ROLE_CENTRAL
    default y

endif

if SHIELD_NOX40_LEFT || SHIELD_NOX40_RIGHT

config ZMK_SPLIT
    default y

endif
```

## boards/shields/nox40/Kconfig.shield
```kconfig
config SHIELD_NOX40_LEFT
    def_bool $(shields_list_contains,nox40_left)

config SHIELD_NOX40_RIGHT
    def_bool $(shields_list_contains,nox40_right)
```

## boards/shields/splitent/Kconfig.defconfig
```kconfig
if SHIELD_SPLITENT_LEFT

config ZMK_KEYBOARD_NAME
    default "Splitent"

config ZMK_SPLIT_ROLE_CENTRAL
    default y

endif

if SHIELD_SPLITENT_LEFT || SHIELD_SPLITENT_RIGHT

config ZMK_SPLIT
    default y

endif
```

## boards/shields/splitent/Kconfig.shield
```kconfig
config SHIELD_SPLITENT_LEFT
    def_bool $(shields_list_contains,splitent_left)

config SHIELD_SPLITENT_RIGHT
    def_bool $(shields_list_contains,splitent_right)
```
